## config/west.yml
```yaml
manifest:
  remotes:
    - name: zmkfirmware
      url-base: https://github.com/zmkfirmware
    - name: sekigon-gonnoc
      url-base: https://github.com/sekigon-gonnoc
  projects:
    - name: zmk
      remote: zmkfirmware
      # Official v0.3-branch, matching the validated PrimeOrb base.
      revision: acfd8e5ea76cf23ad1c9b6b99848f97a95224257
      import: app/west.yml
    - name: zmk-driver-paw3222
      remote: sekigon-gonnoc
      revision: df652881be2520bde4f64ab6ca35e4c5708f4f9b
  self:
    path: config
```

## dts/bindings/behaviors/primeorb,behavior-wheel-step.yaml
```yaml
description: Discrete two-unit mouse wheel event (0 down, 1 up), without a timer or acceleration
compatible: "primeorb,behavior-wheel-step"
include: one_param.yaml
```

## dts/bindings/sensor/primeorb,encoder.yaml
```yaml
description: >
  Full-cycle quadrature sensor for the PrimeOrb EC12E2440301 (24 detents,
  24 pulses). Both active-high GPIOs must be on the same controller.
  Pull-ups make the open/open detent state 11. Samples report degrees.
compatible: "primeorb,encoder"
include: sensor-device.yaml
properties:
  a-gpios:
    type: phandle-array
    required: true
  b-gpios:
    type: phandle-array
    required: true
  detents-per-rotation:
    type: int
    required: true
    const: 24
```
